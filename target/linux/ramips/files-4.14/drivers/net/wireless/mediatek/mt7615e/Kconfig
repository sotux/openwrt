## target/linux/ramips/files-4.14/drivers/net/wireless/mediatek/mt7615e/Kconfig
```kconfig
menu "MT7615E wifi driver"

#############
# Wireless
#############
menuconfig WIFI_DRIVER
	bool "WiFi Driver Support"

if WIFI_DRIVER

choice
	prompt "Choose First WiFi Interface"
	config FIRST_IF_NONE
		bool "None"

	config FIRST_IF_MT7615E
		bool "MT7615E"
		select WIFI_MT_MAC
		select MT_MAC
		select CHIP_MT7615E

endchoice

choice
	prompt "Choose Second WiFi Interface"
	config SECOND_IF_NONE
		bool "None"

	config SECOND_IF_MT7615E
		bool "MT7615E"
		select WIFI_MT_MAC
		select CHIP_MT7615E
endchoice

choice
	prompt "Choose Third WiFi Interface"
	config THIRD_IF_NONE
		bool "None"

	config THIRD_IF_MT7615E
		bool "MT7615E"
		select WIFI_MT_MAC
		select MT_MAC
		select CHIP_MT7615E
endchoice

config  RT_FIRST_CARD
	string
	depends on ! FIRST_IF_NONE
	default 7615e if FIRST_IF_MT7615E
        
config  RT_SECOND_CARD
	string
	depends on ! SECOND_IF_NONE
	default 7615e if SECOND_IF_MT7615E

config  RT_THIRD_CARD
	string
	depends on ! THIRD_IF_NONE
	default 7615e if THIRD_IF_MT7615E
        
config  RT_FIRST_IF_RF_OFFSET
	hex
	depends on ! FIRST_IF_NONE
	default 0x0

config  RT_SECOND_IF_RF_OFFSET
	hex
	depends on ! SECOND_IF_NONE
	default 0x8000

config  RT_THIRD_IF_RF_OFFSET
	hex
	depends on ! THIRD_IF_NONE
	default 0x4000

#SKB alloc selection
config WIFI_SKB_ALLOC_SELECT
    bool "SKB Allocation API Select"
    default n
choice
	prompt "SKB Allocation API Selection"
	depends on WIFI_SKB_ALLOC_SELECT
	default WIFI_PAGE_ALLOC_SKB

	config  WIFI_SLAB_ALLOC_SKB
		bool "SLAB skb allocation"

	config  WIFI_PAGE_ALLOC_SKB
		bool "Page skb allocation"
endchoice

source "drivers/net/wireless/mediatek/mt7615e/mt_wifi/embedded/Kconfig"

endif # WIFI_DRIVER

endmenu
```

## target/linux/ramips/files-4.14/drivers/net/wireless/mediatek/mt7615e/mt_wifi_ap/Kconfig
```kconfig
config MT_AP_SUPPORT
	tristate "Ralink RT2860 802.11n AP support"
	select WIRELESS_EXT
	select WEXT_SPY
	select WEXT_PRIV

config WDS_SUPPORT
	bool "WDS"
	depends on MT_AP_SUPPORT
	default n

config MBSS_SUPPORT
	bool "MBSSID"
	depends on MT_AP_SUPPORT
	default y

config APCLI_SUPPORT
	bool "AP-Client Support"
	depends on MT_AP_SUPPORT
	default y

config APCLI_CERT_SUPPORT
        bool "AP-Client TGn Cert Support"
	depends on MT_AP_SUPPORT
        depends on APCLI_SUPPORT
        default n

config MAC_REPEATER_SUPPORT
	bool "MAC Repeater Support"
	depends on MT_AP_SUPPORT
	depends on APCLI_SUPPORT
	depends on RALINK_RT6352 || RALINK_MT7620 || RALINK_MT7603E || MT_AP_SUPPORT
	default y

config MUMIMO_SUPPORT
        bool "MU-MIMO Support"
        depends on WIFI_DRIVER
        select MU_RA_SUPPORT
        default y

config MU_RA_SUPPORT
  	bool "MU-RGA Support"
  	depends on MUMIMO_SUPPORT
  	
config DOT11R_FT_SUPPORT
	bool "802.11r Fast BSS Transition"
	depends on MT_AP_SUPPORT
	default n

config DOT11K_RRM_SUPPORT
	bool "802.11k Radio Resource Management"
	depends on MT_AP_SUPPORT
	default n

config CFG80211_SUPPORT
	bool "CFG80211"
	depends on MT_AP_SUPPORT
	default n

config CUSTOMIZED_HOSTAPD
	bool "Customized Hostapd Support"
	depends on CFG80211_SUPPORT
	default n

config DSCP_QOS_MAP_SUPPORT
	bool "Dscp Qos Mapping Support"
	depends on MT_AP_SUPPORT
	default n

config CON_WPS_SUPPORT
	bool "Concurrent WPS Support"
	depends on MT_AP_SUPPORT
	depends on APCLI_SUPPORT
	depends on WSC_INCLUDED
	depends on WSC_V2_SUPPORT
	default n

config MCAST_RATE_SPECIFIC
	bool "User specific tx rate of mcast pkt"
	depends on MT_AP_SUPPORT
	default y

config VOW_SUPPORT
	bool "MediaAir(VOW) support"
	depends on MT_AP_SUPPORT
	default y

config BAND_STEERING
	bool "Band Steering"
	depends on MT_AP_SUPPORT
	default n

config LED_CONTROL_SUPPORT
        bool "LED Control Support"
        default y

config RADIUS_ACCOUNTING_SUPPORT
	bool "Radius Accounting Support"
	depends on MT_AP_SUPPORT
	default n
        
config GREENAP_SUPPORT
	bool "GreenAP Support"
	depends on MT_AP_SUPPORT
	default y

config LINUX_NET_TXQ_SUPPORT
	bool "NET TX Queue Support"
	default y
```
